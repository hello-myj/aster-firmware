## boards/osptek_p4/idf/main/Kconfig.projbuild
```kconfig
menu "Aster OSPTEK P4 baseboard V1.5 wiring"
config ASTER_P4_BACKLIGHT_GPIO
    int "BACKLIGHT_GPIO"
    range 0 54
    default 20
config ASTER_P4_LCD_RESET_GPIO
    int "LCD_RESET_GPIO"
    range 0 54
    default 5
config ASTER_P4_TOUCH_SCL_GPIO
    int "TOUCH_SCL_GPIO"
    range 0 54
    default 8
config ASTER_P4_TOUCH_SDA_GPIO
    int "TOUCH_SDA_GPIO"
    range 0 54
    default 7
config ASTER_P4_TOUCH_RESET_GPIO
    int "TOUCH_RESET_GPIO"
    range 0 54
    default 6
config ASTER_P4_TOUCH_INT_GPIO
    int "TOUCH_INT_GPIO"
    range 0 54
    default 21
endmenu
config ASTER_APP_WATCHDOG_MS
    int "Maximum duration of a guest lifecycle/event callback (ms)"
    range 100 30000
    default 2000
config ASTER_P4_AUTORUN_DIAGNOSTIC
    bool "Run SD root app.aot/app.wasm diagnostic automatically at boot"
    default n
    help
        Normally boot directly to the desktop. Run the SD root diagnostic
        explicitly with 'aster app diagnostic' when checking the hardware.
config ASTER_SIGNATURE_VERIFY
    bool "Verify package signatures"
    default n
config ASTER_SIGNATURE_REQUIRE
    bool "Reject unsigned packages"
    depends on ASTER_SIGNATURE_VERIFY
    default y
config ASTER_VENDOR_PUBKEY
    string "Trusted P-256 public key (130 hexadecimal characters)"
    depends on ASTER_SIGNATURE_VERIFY
    default ""

config ASTER_P4_DUAL_CORE_RENDER
    bool "Split launcher pixel rows across both HP cores"
    default y
    help
        CPU1 owns LVGL and VM. CPU0 processes disjoint, cache-aligned rows
        of each ribbon. All jobs join before the next draw or cache release.
config ASTER_P4_TOUCH_I2C_HZ
    int "ST7123 I2C clock (Hz)"
    range 100000 400000
    default 400000
config ASTER_P4_LCD_VFP
    int "LCD vertical front porch (lines)"
    range 160 240
    default 182
    help
        30 MHz / ((480+140+2+120)*(480+8+4+182)) is about 60 Hz.
        The reference example uses 200 lines (about 58.4 Hz).
```

## boards/osptek_p4/idf/sdkconfig.defaults
```kconfig
CONFIG_IDF_TARGET="esp32p4"
CONFIG_ESPTOOLPY_FLASHSIZE_16MB=y
CONFIG_SPIRAM=y
CONFIG_SPIRAM_SPEED_200M=y
CONFIG_ESP_MAIN_TASK_STACK_SIZE=8192
CONFIG_COMPILER_OPTIMIZATION_PERF=y
CONFIG_CACHE_L2_CACHE_128KB=y
CONFIG_IDF_EXPERIMENTAL_FEATURES=y

# CONFIG_WAMR_ENABLE_INTERP is not set
CONFIG_WAMR_ENABLE_AOT=y
CONFIG_WAMR_ENABLE_SHARED_MEMORY=y
# IDF 6 cannot expose executable heap with IDRAM memory protection enabled.
# Required by the private dynamic-AOT profile; see the board README.
# CONFIG_ESP_SYSTEM_MEMPROT is not set
# CONFIG_WAMR_ENABLE_LIBC_WASI is not set
# CONFIG_WAMR_ENABLE_LIB_PTHREAD is not set
CONFIG_FREERTOS_HZ=1000

CONFIG_SLAVE_IDF_TARGET_ESP32C5=y
CONFIG_ESP_WIFI_REMOTE_ENABLED=y
CONFIG_ESP_WIFI_REMOTE_LIBRARY_HOSTED=y
CONFIG_ESP_HOSTED_CP_TARGET_ESP32C5=y
CONFIG_ESP_HOSTED_P4_DEV_BOARD_NONE=y
CONFIG_ESP_HOSTED_SDIO_HOST_INTERFACE=y
CONFIG_ESP_HOSTED_SDIO_SLOT_1=y
CONFIG_ESP_HOSTED_SDIO_4_BIT_BUS=y
CONFIG_ESP_HOSTED_PRIV_SDIO_PIN_CLK_SLOT_1=18
CONFIG_ESP_HOSTED_PRIV_SDIO_PIN_CMD_SLOT_1=19
CONFIG_ESP_HOSTED_PRIV_SDIO_PIN_D0_SLOT_1=14
CONFIG_ESP_HOSTED_PRIV_SDIO_PIN_D1_4BIT_BUS_SLOT_1=15
CONFIG_ESP_HOSTED_PRIV_SDIO_PIN_D2_4BIT_BUS_SLOT_1=16
CONFIG_ESP_HOSTED_PRIV_SDIO_PIN_D3_4BIT_BUS_SLOT_1=17
CONFIG_ESP_HOSTED_SDIO_GPIO_RESET_SLAVE=54
CONFIG_ESP_HOSTED_SDIO_CLOCK_FREQ_KHZ=20000

CONFIG_PARTITION_TABLE_CUSTOM=y
CONFIG_PARTITION_TABLE_CUSTOM_FILENAME="partitions.csv"

CONFIG_FATFS_LFN_HEAP=y
CONFIG_FATFS_MAX_LFN=255
CONFIG_FATFS_API_ENCODING_UTF_8=y
CONFIG_SPIRAM_ALLOW_BSS_SEG_EXTERNAL_MEMORY=y
CONFIG_MBEDTLS_EXTERNAL_MEM_ALLOC=y
```

## boards/waveshare/esp32s3_touch_lcd_35b/Kconfig.waveshare_esp32s3_touch_lcd_35b
```kconfig
# SPDX-License-Identifier: MIT
config BOARD_WAVESHARE_ESP32S3_TOUCH_LCD_35B
	select SOC_ESP32S3_WROOM_N8
	select SOC_ESP32S3_PROCPU
```

## boards/waveshare/esp32s3_touch_lcd_35b/board.yml
```yaml
board:
  name: waveshare_esp32s3_touch_lcd_35b
  full_name: Waveshare ESP32-S3-Touch-LCD-3.5B
  vendor: waveshare
  socs:
  - name: esp32s3
```

## config/Kconfig
```kconfig
mainmenu "Aster firmware configuration"
menu "System and hardware"
choice ASTER_SYSTEM_SELECT
    prompt "Operating system"
    default ASTER_SYSTEM_ZEPHYR
config ASTER_SYSTEM_ZEPHYR
    bool "Zephyr"
endchoice
choice ASTER_HARDWARE_SELECT
    prompt "Hardware model"
    default ASTER_HW_LCKFB_S3
config ASTER_HW_LCKFB_S3
    bool "LCKFB ESP32-S3 ShiZhanPai (N16R8)"
config ASTER_HW_WAVESHARE_35B
    bool "Waveshare ESP32-S3-Touch-LCD-3.5B (N16R8)"
endchoice
endmenu
menu "Startup display (launcher is portrait; APPs select their orientation)"
choice ASTER_BOOT_DISPLAY
    prompt "Display startup mode"
    default ASTER_BOOT_PORTRAIT
config ASTER_BOOT_PORTRAIT
    bool "Portrait"
config ASTER_BOOT_HEADLESS
    bool "Headless (shell and non-graphical applications)"
endchoice
endmenu
menu "Firmware services"
config ASTER_CFG_CAMERA
    bool "Camera"
    depends on !ASTER_HW_WAVESHARE_35B
    default y
config ASTER_CFG_AUDIO
    bool "Audio input and output"
    default y
config ASTER_CFG_WIFI
    bool "Wi-Fi"
    default y
config ASTER_CFG_LAUNCHER
    bool "Built-in system desktop"
    default y
config ASTER_CFG_USB_CONSOLE
    bool "USB-only debugging (shell uses Serial/JTAG; file service paused)"
    depends on ASTER_HW_WAVESHARE_35B
    default n
endmenu
```

## dts/bindings/display/waveshare,axs15231b.yaml
```yaml
# SPDX-License-Identifier: MIT
description: AXS15231B QSPI RGB565 display
compatible: "waveshare,axs15231b"
include: [spi-device.yaml, display-controller.yaml]
```

## dts/bindings/input/focaltech,ft6336-mt.yaml
```yaml
# SPDX-License-Identifier: MIT
description: FocalTech FT6336 two-point capacitive touch controller
compatible: "focaltech,ft6336-mt"
include: i2c-device.yaml
properties:
  screen-width:
    type: int
    required: true
    description: Raw controller X coordinate extent in pixels
  screen-height:
    type: int
    required: true
    description: Raw controller Y coordinate extent in pixels
  poll-interval-ms:
    type: int
    default: 20
    description: Polling interval in milliseconds
```

## dts/bindings/input/waveshare,axs15231b-touch.yaml
```yaml
# SPDX-License-Identifier: MIT
description: AXS15231B I2C capacitive touch controller
compatible: "waveshare,axs15231b-touch"
include: [i2c-device.yaml, touchscreen-common.yaml]
```

## modules/gc0308/Kconfig
```kconfig
# SPDX-License-Identifier: Apache-2.0

config VIDEO_GC0308
	bool "GC0308 CMOS digital image sensor"
	default y
	depends on VIDEO && DT_HAS_GALAXYCORE_GC0308_ENABLED
	select I2C
	help
	  Enable driver for GalaxyCore GC0308 (QVGA RGB565 over DVP).
```

## modules/gc0308/dts/bindings/video/galaxycore,gc0308.yaml
```yaml
# SPDX-License-Identifier: Apache-2.0

description: GalaxyCore GC0308 CMOS video sensor

compatible: "galaxycore,gc0308"

properties:
  reset-gpios:
    type: phandle-array
    description: |
      Optional active-low reset GPIO.

  pwdn-gpios:
    type: phandle-array
    description: |
      Power-down pin. Sensor treats this as active-high (high = powered down).

include: i2c-device.yaml
```

## west.yml
```yaml
manifest:
  version: "1.0"
  projects:
    - name: zephyr
      url: https://github.com/zephyrproject-rtos/zephyr
      revision: dccb09599635bdff17633fa7e9dab014b91dce90
      import: true
  self:
    path: aster-firmware
```
